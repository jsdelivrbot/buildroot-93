## configs/snps_axs101_usb3_defconfig
```kconfig
# Architecture
BR2_arcle=y

# System
BR2_TARGET_GENERIC_HOSTNAME="axs101"
BR2_TARGET_GENERIC_ISSUE="Welcome to the ARC Software Development Platform"
BR2_TARGET_GENERIC_GETTY_OPTIONS="-n -l /usr/bin/autologin"
BR2_TARGET_ROOTFS_INITRAMFS=y
BR2_GLOBAL_PATCH_DIR="custom-packages"
BR2_SYNOPSYS_USB=y
BR2_ROOTFS_OVERLAY="board/synopsys/common-usb/rootfs-overlay"
BR2_ROOTFS_POST_BUILD_SCRIPT="board/synopsys/common-usb/fstab-post-build.sh board/synopsys/common-usb/intf-post-build.sh"

# Linux headers same as kernel, a 3.18 series
BR2_KERNEL_HEADERS_3_18=y

# Kernel
BR2_LINUX_KERNEL=y
BR2_LINUX_KERNEL_CUSTOM_GIT=y
BR2_LINUX_KERNEL_CUSTOM_REPO_URL="https://github.com/foss-for-synopsys-dwc-arc-processors/linux"
BR2_LINUX_KERNEL_CUSTOM_REPO_VERSION="arc-3.18-4"
BR2_LINUX_KERNEL_DEFCONFIG="axs101"
BR2_LINUX_KERNEL_CONFIG_FRAGMENT_FILES="board/synopsys/axs10x-usb3/axs101_usb.fragment"

# Toolchain Options
BR2_TOOLCHAIN_BUILDROOT_INET_RPC=y
BR2_TOOLCHAIN_BUILDROOT_WCHAR=y
BR2_TOOLCHAIN_BUILDROOT_CXX=y

# Packages
BR2_PACKAGE_MPLAYER=y
BR2_PACKAGE_NFS_UTILS=y
BR2_PACKAGE_PERL=y
BR2_PACKAGE_NANO=y
BR2_PACKAGE_USB_SCRIPTS=y
BR2_PACKAGE_CONNMAN=y
BR2_PACKAGE_BUSYBOX_CONFIG_FRAGMENT_FILES="board/synopsys/common-usb/busybox.fragment"

# Bootloader
BR2_TARGET_UBOOT=y
BR2_TARGET_UBOOT_BUILD_SYSTEM_KCONFIG=y
BR2_TARGET_UBOOT_CUSTOM_VERSION=y
BR2_TARGET_UBOOT_CUSTOM_VERSION_VALUE="2016.07"
BR2_TARGET_UBOOT_BOARD_DEFCONFIG="axs101"
```

## configs/snps_axs101_usb3_device_defconfig
```kconfig
# System
BR2_arcle=y
BR2_KERNEL_HEADERS_3_18=y
BR2_TARGET_GENERIC_HOSTNAME="axs101"
BR2_TARGET_GENERIC_ISSUE="Welcome to the ARC Software Development Platform"
BR2_SYSTEM_DHCP="eth0"
BR2_ROOTFS_OVERLAY="board/synopsys/axs10x-usb3/rootfs-overlay"
BR2_TARGET_ROOTFS_INITRAMFS=y

# Custom Kernel
BR2_LINUX_KERNEL=y
BR2_LINUX_KERNEL_PATCH="board/synopsys/axs10x-usb3/patches/linux-kernel"
BR2_LINUX_KERNEL_CUSTOM_GIT=y
BR2_LINUX_KERNEL_CUSTOM_REPO_URL="https://github.com/foss-for-synopsys-dwc-arc-processors/linux"
BR2_LINUX_KERNEL_CUSTOM_REPO_VERSION="db504ccc004330e5387e8a4f2ebe25c74baba6e7"
BR2_LINUX_KERNEL_USE_CUSTOM_CONFIG=y
BR2_LINUX_KERNEL_CUSTOM_CONFIG_FILE="board/synopsys/axs10x-usb3/axs101_usb_device.config"

# Toolchain Options
BR2_TOOLCHAIN_BUILDROOT_INET_RPC=y
BR2_TOOLCHAIN_BUILDROOT_WCHAR=y
BR2_TOOLCHAIN_BUILDROOT_CXX=y
#BR2_TOOLCHAIN_EXTERNAL=y
#BR2_TOOLCHAIN_EXTERNAL_HEADERS_3_18=y
#BR2_TOOLCHAIN_EXTERNAL_GCC_4_8=y
#BR2_TOOLCHAIN_EXTERNAL_WCHAR=y
#BR2_TOOLCHAIN_EXTERNAL_INET_RPC=y
#BR2_TOOLCHAIN_EXTERNAL_CXX=y
# BR2_TOOLCHAIN_EXTERNAL_HAS_THREADS_DEBUG is not set

# Packages
BR2_PACKAGE_MPLAYER=y
BR2_PACKAGE_MPLAYER_MENCODER=y
BR2_PACKAGE_NFS_UTILS=y
BR2_PACKAGE_PERL=y
BR2_PACKAGE_NANO=y
BR2_PACKAGE_USB_SCRIPTS=y

# U-Boot
BR2_TARGET_UBOOT=y
BR2_TARGET_UBOOT_BUILD_SYSTEM_KCONFIG=y
BR2_TARGET_UBOOT_CUSTOM_VERSION=y
BR2_TARGET_UBOOT_CUSTOM_VERSION_VALUE="2015.10"
BR2_TARGET_UBOOT_BOARD_DEFCONFIG="axs101"
```

## configs/snps_axs101_usb3_device_mainline_defconfig
```kconfig
# Architecture
BR2_arcle=y

# System
BR2_TARGET_GENERIC_HOSTNAME="axs101"
BR2_TARGET_GENERIC_ISSUE="Welcome to the ARC Software Development Platform"
BR2_TARGET_ROOTFS_INITRAMFS=y
BR2_SYSTEM_DHCP="eth0"
BR2_ROOTFS_OVERLAY="board/synopsys/axs10x-usb3/rootfs-overlay"

# Kernel
BR2_LINUX_KERNEL=y
BR2_LINUX_KERNEL_CUSTOM_GIT=y
BR2_LINUX_KERNEL_CUSTOM_REPO_URL="git://git.kernel.org/pub/scm/linux/kernel/git/torvalds/linux.git"
BR2_LINUX_KERNEL_CUSTOM_REPO_VERSION="master"
BR2_LINUX_KERNEL_PATCH="board/synopsys/axs10x-usb3/patches/linux-kernel"
BR2_LINUX_KERNEL_USE_CUSTOM_CONFIG=y
BR2_LINUX_KERNEL_CUSTOM_CONFIG_FILE="board/synopsys/axs10x-usb3/axs101_usb_device_mainline.config"

# Bootloader
BR2_TARGET_UBOOT=y
BR2_TARGET_UBOOT_BUILD_SYSTEM_KCONFIG=y
BR2_TARGET_UBOOT_CUSTOM_VERSION=y
BR2_TARGET_UBOOT_CUSTOM_VERSION_VALUE="2015.10"
BR2_TARGET_UBOOT_BOARD_DEFCONFIG="axs101"

# Extra toolchain options
BR2_TOOLCHAIN_BUILDROOT_INET_RPC=y
BR2_TOOLCHAIN_BUILDROOT_WCHAR=y
BR2_TOOLCHAIN_BUILDROOT_CXX=y

# Extra tools for usb tests
BR2_PACKAGE_NCURSES=y
BR2_PACKAGE_USB_SCRIPTS=y
BR2_PACKAGE_PERL=y
BR2_PACKAGE_NANO=y
BR2_PACKAGE_LESS=y
BR2_PACKAGE_NFS_UTILS=y
BR2_PACKAGE_USBUTILS=y
BR2_PACKAGE_HAS_UDEV=y
BR2_PACKAGE_USBMOUNT=y
```

## configs/snps_axs101_usb3_mainline_defconfig
```kconfig
# Architecture
BR2_arcle=y

# System
BR2_TARGET_GENERIC_HOSTNAME="axs101"
BR2_TARGET_GENERIC_ISSUE="Welcome to the ARC Software Development Platform"
BR2_TARGET_GENERIC_GETTY_OPTIONS="-n -l /usr/bin/autologin"
BR2_TARGET_ROOTFS_INITRAMFS=y
BR2_GLOBAL_PATCH_DIR="custom-packages"
BR2_SYNOPSYS_USB=y
BR2_ROOTFS_OVERLAY="board/synopsys/usb/common/rootfs-overlay"
BR2_ROOTFS_POST_BUILD_SCRIPT="board/synopsys/usb/common/fstab-post-build.sh board/synopsys/usb/common/network-post-build.sh"

# Linux headers
BR2_KERNEL_HEADERS_4_7=y

# Custom Kernel
BR2_LINUX_KERNEL=y
BR2_LINUX_KERNEL_CUSTOM_GIT=y
BR2_LINUX_KERNEL_CUSTOM_REPO_URL="git://git.kernel.org/pub/scm/linux/kernel/git/torvalds/linux.git"
BR2_LINUX_KERNEL_CUSTOM_REPO_VERSION="master"
BR2_LINUX_KERNEL_DEFCONFIG="axs101"
BR2_LINUX_KERNEL_CONFIG_FRAGMENT_FILES="board/synopsys/usb/axs10x/axs101_usb.fragment"

# Toolchain Options
BR2_TOOLCHAIN_BUILDROOT_INET_RPC=y
BR2_TOOLCHAIN_BUILDROOT_WCHAR=y
BR2_TOOLCHAIN_BUILDROOT_CXX=y

# Packages
BR2_PACKAGE_MPLAYER=y
BR2_PACKAGE_NFS_UTILS=y
BR2_PACKAGE_PERL=y
BR2_PACKAGE_NANO=y
BR2_PACKAGE_USB_SCRIPTS=y
BR2_PACKAGE_USB_SCRIPTS_VERSION="08a1a3e13219"
BR2_PACKAGE_CONNMAN=y
BR2_PACKAGE_BUSYBOX_CONFIG_FRAGMENT_FILES="board/synopsys/usb/common/busybox.fragment"

# Bootloader
BR2_TARGET_UBOOT=y
BR2_TARGET_UBOOT_BUILD_SYSTEM_KCONFIG=y
BR2_TARGET_UBOOT_CUSTOM_VERSION=y
BR2_TARGET_UBOOT_CUSTOM_VERSION_VALUE="2016.07"
BR2_TARGET_UBOOT_BOARD_DEFCONFIG="axs101"
```

## configs/snps_juno_usb3_defconfig
```kconfig
BR2_aarch64=y
BR2_ROOTFS_OVERLAY="board/synopsys/usb/common/rootfs-overlay"
BR2_PACKAGE_HOST_LINUX_HEADERS_CUSTOM_4_6=y
BR2_TARGET_GENERIC_HOSTNAME="juno-buildroot"
BR2_TARGET_GENERIC_ISSUE="Welcome to SNPS Juno by Buildroot"
BR2_TARGET_GENERIC_GETTY_OPTIONS="-n -l /usr/bin/autologin"
BR2_LINUX_KERNEL=y
BR2_LINUX_KERNEL_CUSTOM_GIT=y
BR2_LINUX_KERNEL_CUSTOM_REPO_URL="git://git.kernel.org/pub/scm/linux/kernel/git/torvalds/linux.git"
BR2_LINUX_KERNEL_CUSTOM_REPO_VERSION="v4.6"
BR2_LINUX_KERNEL_USE_CUSTOM_CONFIG=y
BR2_LINUX_KERNEL_CUSTOM_CONFIG_FILE="board/arm/juno/linux-juno-defconfig"
BR2_LINUX_KERNEL_CONFIG_FRAGMENT_FILES="board/synopsys/usb/juno/linux.fragment"
BR2_LINUX_KERNEL_DTS_SUPPORT=y
BR2_LINUX_KERNEL_INTREE_DTS_NAME="arm/juno arm/juno-r1 arm/juno-r2"
BR2_GLOBAL_PATCH_DIR="custom-packages"
BR2_TARGET_ARM_TRUSTED_FIRMWARE=y
BR2_TARGET_ARM_TRUSTED_FIRMWARE_CUSTOM_GIT=y
BR2_TARGET_ARM_TRUSTED_FIRMWARE_CUSTOM_REPO_URL="https://github.com/ARM-software/arm-trusted-firmware.git"
BR2_TARGET_ARM_TRUSTED_FIRMWARE_CUSTOM_REPO_VERSION="v1.2"
BR2_TARGET_ARM_TRUSTED_FIRMWARE_PLATFORM="juno"
BR2_TARGET_UBOOT=y
BR2_TARGET_UBOOT_BOARDNAME="vexpress_aemv8a_juno"
BR2_TARGET_UBOOT_CUSTOM_VERSION=y
BR2_TARGET_UBOOT_CUSTOM_VERSION_VALUE="2016.03"
BR2_TARGET_VEXPRESS_FIRMWARE=y
BR2_TARGET_ROOTFS_EXT2=y
BR2_TARGET_ROOTFS_EXT2_4=y
BR2_TARGET_ROOTFS_EXT2_BLOCKS=256000
BR2_ROOTFS_POST_IMAGE_SCRIPT="board/synopsys/usb/juno/genimg-sd-post-image.sh board/synopsys/usb/juno/genimg-rootfs-post-image.sh board/synopsys/usb/juno/clean-post-image.sh"
BR2_ROOTFS_POST_BUILD_SCRIPT="board/synopsys/usb/common/fstab-post-build.sh board/synopsys/usb/common/network-post-build.sh"
BR2_PACKAGE_ALSA_UTILS=y
BR2_PACKAGE_ALSA_UTILS_APLAY=y
BR2_PACKAGE_FFMPEG=y
BR2_PACKAGE_FFMPEG_FFPLAY=y
BR2_PACKAGE_SDL_SOUND=y
BR2_PACKAGE_PCIUTILS=y
BR2_PACKAGE_IRQBALANCE=y
BR2_PACKAGE_MPLAYER=y
BR2_PACKAGE_HDPARM=y
BR2_PACKAGE_PERL=y
BR2_PACKAGE_NANO=y
BR2_PACKAGE_USB_SCRIPTS=y
BR2_PACKAGE_CONNMAN=y
BR2_PACKAGE_HOST_GENIMAGE=y
BR2_PACKAGE_HOST_DOSFSTOOLS=y
BR2_PACKAGE_BUSYBOX_CONFIG_FRAGMENT_FILES="board/synopsys/usb/common/busybox.fragment"
```

## package/usb-scripts/Config.in
```kconfig
config BR2_PACKAGE_USB_SCRIPTS
	bool "usb-scripts"
	help
	  Extra utilties for usb tests

config BR2_PACKAGE_USB_SCRIPTS_VERSION
	string "usb-scripts version"
	default "master"
```
